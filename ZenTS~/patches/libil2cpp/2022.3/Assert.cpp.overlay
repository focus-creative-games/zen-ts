#include "os/Assert.h"

#if IL2CPP_DEBUG

#if IL2CPP_TARGET_WINDOWS || IL2CPP_TARGET_XBOXONE || IL2CPP_TARGET_WINRT || IL2CPP_TARGET_WINDOWS_GAMES

#include <cstdio>
#include <cstdlib>

#if defined(_MSC_VER)
#include <intrin.h>
/* Avoid #include <windows.h> -- Bee lumps this with LibraryLoader (winsock clash).
   Do NOT redeclare Win32 APIs here either: the same lump may already include them. */
extern "C" __declspec(dllimport) int __stdcall IsDebuggerPresent(void);
extern "C" __declspec(dllimport) void __stdcall OutputDebugStringA(const char*);
#endif

// ZenTS development override: do NOT call _CrtDbgReport / CRT abort popup.
// Log assertion details, then _exit(3) so unattended runs fail cleanly with file/line in the log.
//
// Log path resolution (all attempted):
//   1) env ZENTS_ASSERT_LOG
//   2) cwd\zents_il2cpp_assert.log
//   3) %TEMP%\zents_il2cpp_assert.log
static void zents_append_assert_file(const char* path, const char* message)
{
    if (path == nullptr || path[0] == '\0')
        return;
    FILE* f = std::fopen(path, "a");
    if (f == nullptr)
        return;
    std::fputs(message, f);
    std::fflush(f);
    std::fclose(f);
}

static void zents_write_assert_log(const char* assertion, const char* file, unsigned int line)
{
    char message[4096];
    std::snprintf(
        message,
        sizeof(message),
        "========== IL2CPP_ASSERT FAILED ==========\n"
        "expr: %s\n"
        "file: %s\n"
        "line: %u\n"
        "==========================================\n\n",
        assertion != nullptr ? assertion : "(null)",
        file != nullptr ? file : "(null)",
        line);

    std::fputs(message, stderr);
    std::fflush(stderr);

#if defined(_MSC_VER)
    OutputDebugStringA(message);
#endif

    const char* primary = std::getenv("ZENTS_ASSERT_LOG");
    if (primary != nullptr && primary[0] != '\0')
        zents_append_assert_file(primary, message);

    zents_append_assert_file("zents_il2cpp_assert.log", message);

    const char* tempDir = std::getenv("TEMP");
    if (tempDir == nullptr || tempDir[0] == '\0')
        tempDir = std::getenv("TMP");
    if (tempDir != nullptr && tempDir[0] != '\0')
    {
        char tempPath[1024];
        std::snprintf(tempPath, sizeof(tempPath), "%s\\zents_il2cpp_assert.log", tempDir);
        zents_append_assert_file(tempPath, message);
    }
}

void il2cpp_assert(const char* assertion, const char* file, unsigned int line)
{
    zents_write_assert_log(assertion, file, line);

#if defined(_MSC_VER)
    /* Suppress CRT "abort() has been called" modal (hides file/line). */
    _set_abort_behavior(0, _WRITE_ABORT_MSG | _CALL_REPORTFAULT);
    if (IsDebuggerPresent())
        __debugbreak();
    /* _exit: no CRT abort dialog, no atexit. */
    _exit(3);
#else
    std::abort();
#endif
}

#endif // IL2CPP_TARGET_WINDOWS || IL2CPP_TARGET_XBOXONE || IL2CPP_TARGET_WINRT

#endif // IL2CPP_DEBUG
